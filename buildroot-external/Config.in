## buildroot-external/Config.in
```kconfig
menu "Additional external python modules"
	source "$BR2_EXTERNAL_WEATHERSTATION_PATH/package/python-sht31/Config.in"
endmenu
```

## buildroot-external/package/python-sht31/Config.in
```kconfig
config BR2_PACKAGE_PYTHON_SHT31
	bool "python-sht31"
	help
	  Python library for the SHT31 temperature and humidity
	  sensor.

	  https://github.com/prdktntwcklr/python-sht31
```
